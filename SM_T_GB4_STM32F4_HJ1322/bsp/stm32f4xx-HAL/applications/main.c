/***************************
**
****************************/
 
 
 
#include <rtthread.h>
#include <board.h>

#include "dfs_fs.h"


#include "common.h"
#include "pro_data.h"

#include "drv_gpio.h"
#include "drv_watchdog.h"
#include "drv_timer.h"
#include "drv_gpio.h"
#include "drv_power.h"

#include "app_lte.h"
#include "app_led.h"
#include "app_gnss.h"
#include "app_mon.h"
#include "app_can_recv.h"
#include "app_files.h"
#include "app_sms.h"
#include "app_iap.h"
#include "app_edge.h"
#include "app_products.h"
#include "app_at.h"
#include "app_can_send.h"
#include "app_watchdog.h"
#include "app_led.h"
#include "app_main.h"
#include "app_shell.h"



#define STM32_WKUP_TIMEOUT 				20            	/** STM32 **/
#define WATCHDOG_RESET_TIMEOUT    25            	/** 鍠傜嫍鏃堕棿**/


//uint8_t st[] = {0x00,0x01,0x02,0x03,0x04,0x05,0x06,0x07,0x08,0x09,0x0A,0x0B,0x0C,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0xFE,0xFF};
//uint8_t st[] = {0x01,0x10,0x04,0x0E,0x00,0x05,0x0A,0x00,0x03,0x00,0x1E,0x01,0x01,0x00,0x01,0x01,0x01};

/******** ********/

static uint8_t						sleep_work_flag = 0;          //

static uint8_t            sys_run_status = 0;             //

static rt_mq_t 						app_main_mq	= NULL;      //

/********	********/

static rt_thread_t tid_gnss = RT_NULL;
static rt_thread_t tid_lte = RT_NULL;
static rt_thread_t tid_at = RT_NULL;
static rt_thread_t tid_can_recv = RT_NULL;
static rt_thread_t tid_packet = RT_NULL;
static rt_thread_t tid_products = RT_NULL;
static rt_thread_t tid_shell = RT_NULL;
static rt_thread_t tid_can_send = RT_NULL;
static rt_thread_t tid_sms = RT_NULL;
static rt_thread_t tid_led = RT_NULL;
static rt_thread_t tid_edge = RT_NULL;
static rt_thread_t tid_gb4 = RT_NULL;




/********************************
**
**********************************/

rt_mq_t get_app_main_queue(void)
{
	return app_main_mq;
}


/**********************************
**	 
**********************************/

void create_app_thread(void)
{
	tid_can_recv = rt_thread_create("can_recv",			thread_entry_can, 			RT_NULL,2048, 9, 20); 
  if(tid_can_recv != RT_NULL)
	{
    rt_thread_startup(tid_can_recv);
	}
	
	tid_shell = rt_thread_create("shell",			thread_entry_shell, 		NULL,2048, 10, 20); 
  if(tid_shell != RT_NULL)
	{
    rt_thread_startup(tid_shell);
	}
	
	tid_can_send = rt_thread_create("can_sned",thread_entry_can_send, 	RT_NULL,2048, 11, 20);
	if(tid_can_send != RT_NULL)
	{
    rt_thread_startup(tid_can_send);
	}
	
	tid_gnss = rt_thread_create("gnss",				 thread_entry_gnss, 		RT_NULL,1024, 12, 20);        
	if(tid_gnss != RT_NULL)
	{
    rt_thread_startup(tid_gnss);	
	}
	
	tid_lte = rt_thread_create("lte",				  thread_entry_lte,		RT_NULL,2048,	13,	20);       
  if(tid_lte != RT_NULL)  
	{
		rt_thread_startup(tid_lte);
	}
	
	tid_at = rt_thread_create("at",				thread_entry_at_parse, RT_NULL,1024,14, 20); 
  if(tid_at != RT_NULL)
	{
    rt_thread_startup(tid_at);
	}

	tid_packet = rt_thread_create("packet",		        thread_entry_packet, 		RT_NULL,2048, 15, 20);
  if(tid_packet != RT_NULL)
	{
    rt_thread_startup(tid_packet);
	}
	
	tid_gb4 = rt_thread_create("gb4",       thread_entry_gb4,   RT_NULL,2048,16,20);
	if(tid_gb4 != RT_NULL)
	{
		rt_thread_startup(tid_gb4);
	}
	
	tid_sms = rt_thread_create("sms",		 	thread_entry_sms, 	    RT_NULL,1536, 17, 20);
	if(tid_sms != RT_NULL)
	{
    rt_thread_startup(tid_sms);
	}
	
		
	tid_products = rt_thread_create("products",			thread_entry_products, 	NULL,2048, 18, 20);
	if(tid_products != NULL)
	{
    rt_thread_startup(tid_products);
	}
	
	tid_edge = rt_thread_create("edge",	thread_entry_edge, 	   RT_NULL,1024, 19, 20); 
		
	if(tid_edge != RT_NULL)
	{
		rt_thread_startup(tid_edge);	
	}
	
	tid_led = rt_thread_create("led",		thread_entry_led, 		RT_NULL,512, 29, 20); 
	if(tid_led != RT_NULL)
	{
    rt_thread_startup(tid_led);	
	}
}



/*********************************
**	
**********************************/

void delete_app_thread(void)
{
	if(tid_gnss != NULL)                 //
	{
		rt_thread_delete(tid_gnss);
	}
	
	if(tid_lte != NULL)
	{
		rt_thread_delete(tid_lte);
	}
	
	if(tid_at != NULL)
	{
		rt_thread_delete(tid_at);
	}
	
	if(tid_can_recv != NULL)
	{
		rt_thread_delete(tid_can_recv);
	}
	
	if(tid_packet != NULL)
	{
		rt_thread_delete(tid_packet);
	}
	
	
	if(tid_shell != NULL)
	{
		rt_thread_delete(tid_shell);
	}
	
	if(tid_can_send != NULL)
	{
		rt_thread_delete(tid_can_send);
	}
	
	if(tid_sms != NULL)
	{
		rt_thread_delete(tid_sms);
	}
	
	if(tid_led != NULL)
	{
		rt_thread_delete(tid_led);
	}
		
	if(tid_edge != NULL)
	{
		rt_thread_delete(tid_edge);
	}
		
	if(tid_gb4 != NULL)
	{
		rt_thread_delete(tid_gb4);
	}
	
	if(tid_products != NULL)
	{
		rt_thread_delete(tid_products);
	}
	
	rt_irq_timer3_resethook();            //
	
	if(unmount_files_sys() == 0)
	{
		rt_kprintf("-- unmount files sys .... ok\r\n");
	}
}


/*****************************
**	
*****************************/

void acc_irq_call_back(void *args)
{
	//rt_kprintf("-- acc_irq_call_back\r\n");
	sleep_work_flag = 1;
}


/*****************************
**	
******************************/

void alarm_irq_call_back(void *args)
{
	//rt_kprintf("-- alarm_irq_call_back\r\n");
	sleep_work_flag = 1;
}



/********************************
**  
**********************************/

uint8_t read_sys_run_state(void)
{
    uint8_t rv;

    rv = sys_run_status;

    return rv;
}





/*********************
**	int main(void)
***************************/

int main(void)
{
	struct app_main_mq_t      	amq = {0};
	uint32_t 										cnt = 0;
	uint32_t 										wkup_time = 0;
	struct rt_tm								tm;
	
	set_watchdog_cycle(20);    //
	rt_pin_attach_irq(PIN_ACC_STATE,PIN_IRQ_MODE_RISING,acc_irq_call_back,NULL);
	rt_pin_irq_enable(PIN_ACC_STATE,PIN_IRQ_ENABLE);
	app_main_mq = rt_mq_create("app_main_mq",sizeof(struct app_main_mq_t),1,RT_IPC_FLAG_FIFO);    //
	
	load_products_cfg_info();                       //
	open_input();
	create_app_thread();
	
	for(;;)
	{
		//cnt = calc_crc16(st,sizeof(st));  //测试使用
		//rt_kprintf("-- the data crc value:0x%X\r\n",cnt);
		process_input();
		if(rt_mq_recv(app_main_mq,&amq,sizeof(struct app_main_mq_t),10) == RT_EOK)         //
		{
			if(amq.state == 1)
      {
				sys_run_status = 4;
        cnt = 0;
        rt_kprintf("-- reboot ....\r\n");
      }
			
			if(amq.state == 2)
			{
				sys_run_status = 3;
        cnt = 0;
			}
      memset((uint8_t *)&amq,0,sizeof(struct app_main_mq_t));
		}
				
		switch(sys_run_status)
		{
			case 0:
				if(read_in_acc_state() > 0)  
				{
					cnt = 0;
					break;
				}
				wkup_time = read_config_sleep_time();           //
				sys_run_status++;
				cnt = 0;
				rt_get_rtc(&tm);
				rt_kprintf("-- Acc off time: 20%d,%d,%d %d-%d-%d\r\n",tm.year,tm.mon,tm.day,tm.hour,tm.min,tm.sec);
				break;
			case 1:
				if(read_in_acc_state() > 0)
				{
					sys_run_status = 0;
					break;
				}
				//if(cnt++ < 50)            // 
				if(cnt++ < 2850)            //        
					break;
				
				cnt = 0;
				sys_run_status++;
				break;
			case 2:
				if(read_in_acc_state() > 0)
				{
					sys_run_status = 1;
					break;
				}
				if(cnt++ < 150)    //等待关闭
					break;
				sys_run_status++;
				break;
			case 3:
				set_watchdog_cycle(25);   //休眠状态下 喂狗周期  25S
				sleep_work_flag = 0;
				delete_app_thread();    //
				rt_set_rtc_wkup(20);
				rt_led_yellow_off();								//					
				rt_led_blue_off();									//
				rt_led_green_off();									//
				rt_led_red_off();
				close_gnss_module();                //
				close_lte_module();									//注意这个函数的使用 ？？？？？
				rt_can1_stb_on();										//使CAN1进入休眠模式
				rt_can2_stb_on();										//使CAN2进入休眠模式
				can_port_close();
				rt_hw_gpio_close();									//关闭
				rt_mem_power_off();									//关闭闪存电源

				rt_kprintf("-- enter sleep .....\r\n");
				rt_thread_delay(10);
				close_shell_module();								//
				close_input();
				
				while(1)
				{
					if(read_in_acc_state() > 0 || sleep_work_flag > 0 || (wkup_time < (STM32_WKUP_TIMEOUT + 1) && (read_in_batter_vol() > 37 || read_in_power_vol() > 80)))        //电锁信号打开
					{
						rt_reboot_sys();      //
					}
					
					//休眠唤醒报警
					if(read_in_power_vol() < 80 && read_in_power_back() >= 80 && read_in_batter_vol() > 37)
					{
						rt_reboot_sys();      //
					}
					
					feed_watchdog_fun();    //喂狗 
					rt_enter_sleep_model();   //
					rt_exit_sleep_model();		//退出睡眠模式
					open_input();           //开启输入采集
					cnt = 5;
					while(cnt--)
					{
						rt_thread_delay(1);
						process_input();
					}
					wkup_time -= (STM32_WKUP_TIMEOUT + 1);                       //
					//rt_kprintf("-- the wake:%u,%u,%d\r\n",read_in_power_vol(),wkup_time,read_in_power_back());
					//rt_thread_delay(10);
					close_input();
				}
				//break;
			case 4:
				if(cnt++ > 100)
        {
          delete_app_thread();       //
          rt_thread_delay(100);      //
          rt_reboot_sys();     		
        }
				break;
			default:
				sys_run_status = 0;
				break;
		}

		feed_watchdog_fun();  //喂狗
	}	
}
